## conf/layer.conf
```bitbake
# We have a conf and classes directory, add to BBPATH
BBPATH .= ":${LAYERDIR}"

# We have a recipes-* directories, add to BBFILES
BBFILES += "${LAYERDIR}/recipes-*/*/*.bb \
            ${LAYERDIR}/recipes-*/*/*.bbappend"

BBFILE_COLLECTIONS += "bct-rx3"
BBFILE_PATTERN_bct-rx3 := "^${LAYERDIR}/"
BBFILE_PRIORITY_bct-rx3 = "6"

LAYERDEPENDS_bct-rx3 = "core fsl-arm"
```

## conf/machine/bct-re3.conf
```bitbake
#@TYPE: Machine
#@NAME: Blue Chip Technology RE3
#@SOC: i.MX6Q
#@DESCRIPTION: Machine configuration for Blue Chip Technology RE3 boards
#

include conf/machine/include/imx-base.inc
include conf/machine/include/tune-cortexa9.inc

SOC_FAMILY = "mx6:mx6q"

XSERVER += "xf86-video-fbdev xf86-input-tslib"

UBOOT_SUFFIX = "img"
SPL_BINARY = "SPL"
UBOOT_PADDING = "2"
PREFERRED_PROVIDER_u-boot = "u-boot-bct"
PREFERRED_PROVIDER_virtual/kernel ?= "linux-bct-re3"
KERNEL_DEVICETREE ?= "bctre3.dtb"

UBOOT_MACHINE ?= "re3spl_config"

SERIAL_CONSOLE = "115200 ttymxc0"

MACHINE_FEATURES += "bluetooth pci wifi touchscreen"
```

## conf/machine/bct-rm3.conf
```bitbake
#@TYPE: Machine
#@NAME: Blue Chip Technology RM3
#@SOC: i.MX6Q
#@DESCRIPTION: Machine configuration for Blue Chip Technology RM3 boards
#

include conf/machine/include/imx-base.inc
include conf/machine/include/tune-cortexa9.inc

SOC_FAMILY = "mx6:mx6q"

XSERVER += "xf86-video-fbdev xf86-input-tslib"

UBOOT_SUFFIX = "img"
UBOOT_PADDING = "2"
SPL_BINARY = "SPL"
PREFERRED_PROVIDER_u-boot = "u-boot-bct"
PREFERRED_PROVIDER_virtual/kernel ?= "linux-bct-rm3"
KERNEL_DEVICETREE ?= "bctrm3.dtb"

UBOOT_MACHINE ?= "rm3spl_config"

SERIAL_CONSOLE = "115200 ttymxc0"

MACHINE_FEATURES += " pci"
```

## conf/machine/bct-rx3.conf
```bitbake
#@TYPE: Machine
#@NAME: Blue Chip Technology Rx3
#@SOC: i.MX6Q
#@DESCRIPTION: Machine configuration for Blue Chip Technology Rx3 boards
#
# By default, this machine will build for the 1GB RM3 option.
#
# To build U-Boot for other options, you can set the UBOOT_MACHINE
# variable in your local.conf according to the following table:
#
# Board  Processor           Memory    Configuration
# -----  --------------      ------    --------------------
# RM3    i.MX6Quad/Dual       1GB      bctrm3_config
# RE3    i.MX6Quad/Dual       1GB      bctre3_config
#

include conf/machine/include/imx-base.inc
include conf/machine/include/tune-cortexa9.inc

SOC_FAMILY = "mx6:mx6q"

XSERVER += "xf86-video-fbdev"

UBOOT_SUFFIX = "bin"
UBOOT_PADDING = "2"
PREFERRED_PROVIDER_u-boot = "u-boot-bct"
PREFERRED_PROVIDER_virtual/kernel ?= "linux-bct"

UBOOT_MACHINE ?= "bctrm3_config"

SERIAL_CONSOLE = "115200 ttymxc0"

MACHINE_FEATURES += " pci"
```
